// Copyright 2021 Manna Harbour
// https://github.com/manna-harbour/miryoku

#include "../modules/miryoku_zmk/miryoku/custom_config.h"
#include "../modules/miryoku_zmk/miryoku/mapping/42/corne.h"
#include "../modules/miryoku_zmk/miryoku/miryoku.dtsi"
